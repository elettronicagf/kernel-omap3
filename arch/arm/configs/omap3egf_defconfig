## drivers/video/omap2/displays/Kconfig
```kconfig
menu "OMAP2/3 Display Device Drivers"
        depends on OMAP2_DSS

config PANEL_GENERIC
        tristate "Generic Panel"
        help
	  Generic panel driver.
	  Used for DVI output for Beagle and OMAP3 SDP.

config PANEL_SHARP_LS037V7DW01
        tristate "Sharp LS037V7DW01 LCD Panel"
        depends on OMAP2_DSS
        select BACKLIGHT_CLASS_DEVICE
        help
          LCD Panel used in TI's SDP3430 and EVM boards
          
config PANEL_EGF_BLC1089
        tristate "Elettronica GF BLC1089 LCD Panel"
        depends on OMAP2_DSS_DPI
        select BACKLIGHT_CLASS_DEVICE
        help
          LCD Panel used in TI eGF 377 BaseBoard
          
config PANEL_EGF_TX20D26VM0AAA
        tristate "TX20D26VM0AAA LCD Panel"
        depends on OMAP2_DSS_DPI
        select BACKLIGHT_CLASS_DEVICE
        help
          LCD Panel used in 0458 Board

config PANEL_EGF_AM800600J1TMQW
        tristate "AM800600J1TMQW LCD Panel"
        depends on OMAP2_DSS_DPI
        select BACKLIGHT_CLASS_DEVICE
        help
          AlternativeLCD Panel used in 0458 Board

config PANEL_EGF_13080SMTB00A0S
        tristate "13-080SMTB00A0-S LCD Panel"
        depends on OMAP2_DSS_DPI
        select BACKLIGHT_CLASS_DEVICE
        help
          Alternative LCD Panel used in 0458 Board

config PANEL_SHARP_LQ043T1DG01
        tristate "Sharp LQ043T1DG01 LCD Panel"
        depends on OMAP2_DSS
        help
          LCD Panel used in TI's OMAP3517 EVM boards

config PANEL_TAAL
        tristate "Taal DSI Panel"
        depends on OMAP2_DSS_DSI
        help
          Taal DSI command mode panel from TPO.

config PANEL_TOPPOLY_TDO35S
        tristate "Toppoly TDO35S LCD Panel support"
        depends on OMAP2_DSS
        help
          LCD Panel used in CM-T35

config PANEL_TPO_TD043MTEA1
        tristate "TPO TD043MTEA1 LCD Panel"
        depends on OMAP2_DSS && SPI
        help
          LCD Panel used in OMAP3 Pandora

config PANEL_ACX565AKM
	tristate "ACX565AKM Panel"
	depends on OMAP2_DSS_SDI && SPI
	select BACKLIGHT_CLASS_DEVICE
	help
	  This is the LCD panel used on Nokia N900
endmenu
```
